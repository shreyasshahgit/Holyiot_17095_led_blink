## CMakeLists.txt
```
cmake_minimum_required(VERSION 3.20.0)

find_package(Zephyr REQUIRED HINTS $ENV{ZEPHYR_BASE})

project(holyiot_led_blink)

target_sources(app PRIVATE src/main.c)
```

## prj.conf
```kconfig
CONFIG_GPIO=y
CONFIG_BOARD_HOLYIOT_YJ17095=y   # optional but good

# For better debugging
CONFIG_CONSOLE=y
CONFIG_UART_CONSOLE=y
CONFIG_LOG=y
CONFIG_LOG_MODE_IMMEDIATE=y
```

## boards/holyiot_yj17095.overlay
```dts
/ {
    aliases {
        led0 = &status_led;
    };

    leds {
        compatible = "gpio-leds";
        status_led: led_0 {
            gpios = <&gpio0 29 GPIO_ACTIVE_HIGH>;
            label = "User LED (P0.29)";
        };
    };
};
```

## src/main.c
```c
#include <zephyr/kernel.h>
#include <zephyr/drivers/gpio.h>

#define LED_PIN 29

int main(void)
{
    const struct device *gpio0 = DEVICE_DT_GET(DT_NODELABEL(gpio0));

    if (!device_is_ready(gpio0)) {
        return 0;
    }

    gpio_pin_configure(gpio0, LED_PIN, GPIO_OUTPUT);

    while (1) {
        gpio_pin_set(gpio0, LED_PIN, 1);
        k_msleep(500);

        gpio_pin_set(gpio0, LED_PIN, 0);
        k_msleep(500);
    }
}
```
